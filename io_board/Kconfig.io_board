## io_board/board.yml
```yaml
board:
  name: io_board
  full_name: TESS IO Controller Board
  vendor: tess
  socs:
    - name: stm32h743xx
```

## tess_f446_led/board.yml
```yaml
board:
  name: tess_f446_led
  full_name: Nucleo F446ZE
  vendor: st
  socs:
    - name: stm32f446xx
```

## tess_h753_led/Kconfig.tess_h753_led
```kconfig
# Copyright (c) 2021 Blue Clover Devices
# SPDX-License-Identifier: Apache-2.0

config BOARD_TESS_H753_LED
	select SOC_STM32H753XX
```

## tess_h753_led/board.yml
```yaml
board:
  name: tess_h753_led
  full_name: Nucleo H753ZI
  vendor: st
  socs:
    - name: stm32h753xx
```
